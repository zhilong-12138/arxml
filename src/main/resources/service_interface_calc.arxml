AUTOSAR XML (schema 00048)
package /fawsn/hinge/interface_deployment
  someip service interface deployment calc_deployment: service-interface=calc, service-interface-id=100
    someip event deployment someip_event_HexResult: event=HexResult, event-id=111, transport-protocol=TCP
    someip field deployment someip_field_CurrentTime: field=CurrentTime
      get getter: method-id=121
      notifier notifier: event-id=112, transport-protocol=TCP
    someip method deployment someip_method_calculate: method=calculate, method-id=122, transport-protocol=TCP
    someip method deployment someip_method_DecToHex: method=DecToHex, method-id=123, transport-protocol=TCP
    someip event group someip_event_group: event-group-id=131, event=[someip_event_HexResult, notifier]
  user defined service interface deployment calc_deployment_ipc: service-interface=calc
package /fawsn/hinge/interface
  service interface calc
    namespaces:
      symbol props fawsn
      symbol props hinge
      symbol props calc
    events:
      data HexResult: type=string
    field CurrentTime: type=float, has-getter=true, has-notifier=true, has-setter=false
    methods:
      operation calculate
        arg num: type=OperatingNumber, direction=IN
        arg opt: type=Operator, direction=IN
        arg OperatingResult: type=int64_t, direction=OUT
      operation DecToHex
        arg DecNum: type=uint32_t, direction=IN
        arg result: type=bool, direction=OUT
